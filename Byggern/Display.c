/*
 * Display.c
 *
 * Created: 02.10.2025 08:52:30
 *  Author: johankna
 */ 

#define display_width 128
#define display_height 64
#define display_pages (display_height/8)

#include "Includes.h"

const unsigned char font8[95][8] PROGMEM;
const unsigned char font5[95][5] PROGMEM;
const unsigned char font4[95][4] PROGMEM;

volatile uint8_t *ext_ram = (uint8_t *) 0x1400;


void display_cmd(uint8_t* command, int size){
	clearBit(PORTB, PB1);
	spi_write_bytes(command, size, DISPLAY);
}

void display_data(uint8_t* data, int size){
	setBit(PORTB, PB1);
	spi_write_bytes(data, size, DISPLAY);
}


void display_initialize(){
	uint8_t display_off []= {0xae};
	display_cmd(display_off, sizeof(display_off));
	
	uint8_t segment_remap [] = {0xa1};
	display_cmd(segment_remap,1);
		
	uint8_t common_output []= {0xc8};
	display_cmd(common_output,1);
	
	uint8_t display_divide_array [] = {0xd5,0x80}; // display divide ratio and osc freq mode
	display_cmd(display_divide_array,2);

	uint8_t contrast_control_array [] = {0x81,0xFF}; // contrast control, set to max
	display_cmd(contrast_control_array,2);
	
	uint8_t pre_charge_array [] = {0xd9,0x21}; // pre charge and pre charge option
	display_cmd(pre_charge_array,2);
	
	uint8_t memory_addressing_array [] = {0x20,0x02}; // memory adressing and memory adressing option, set to page adressing mode
	display_cmd(memory_addressing_array,2);
	
	uint8_t page_start []= {0xb0}; // f�rste page = 0
	display_cmd(page_start,1);
	
	uint8_t RAM_content [] = {0xa4};
	display_cmd(RAM_content,1);
	
	uint8_t normal_display [] = {0xa6}; // 
	display_cmd(normal_display,1);
	
	uint8_t display_on []= {0xaf};
	display_cmd(display_on,1);
	
	display_go_to_column(0);
}

// Do the same as if we used the RES pin
void display_reset(){ 
	uint8_t display_off []= {0xae}; // dispaly off
	display_cmd(display_off, sizeof(display_off));

	uint8_t contrast_control_array [] = {0x81,0x7F}; // contrast control, set to max
	display_cmd(contrast_control_array,2);

	uint8_t line_control_array [] = {0x40}; // start line to 0
	display_cmd(line_control_array,1);

	uint8_t normal_display [] = {0xa6}; // normal display
	display_cmd(normal_display,1);

	uint8_t segment_remap [] = {0xa0}; //normal map
	display_cmd(segment_remap,1);

	uint8_t common_output []= {0xc0};
	display_cmd(common_output,1);

	uint8_t page_start []= {0xb0}; // f�rste page = 0
	display_cmd(page_start,1);

	uint8_t col_start []= {0x00}; // start column = 0
	display_cmd(col_start,1);

	uint8_t col_end []= {0x10}; // end column = last column
	display_cmd(col_end,1);

	uint8_t display_on []= {0xaf};
	display_cmd(display_on,1);
}

void display_clear(){
	for(int i = 0; i < 128; i++){
			ext_ram[i] = 0x00;	
	}

	for(uint8_t j = 0; j < 8; j++){
		//uint8_t page_start []= {0xb0 | j}; // f�rste page = 0
		//display_cmd(page_start,1);
		//display_data(display_buffer, sizeof(display_buffer));
		display_clear_line(j);
	}
}

void display_home() {

}

uint8_t display_validate_line(uint8_t line) {
	if(line > 63 || line < 0) return -1;
	uint8_t page;
	page = line/8;
	return page;
}

void display_go_to_line(uint8_t line){
	line = display_validate_line(line);
	if(line == -1) return;
	uint8_t page_start []= {0xb0 | line};
	display_cmd(page_start,1);
}

void display_clear_line(uint8_t line){
	display_go_to_line(line);
	uint8_t clear_buffer[128];
	for(int i = 0; i < 128; i++){
		clear_buffer[i] = 0x00;	
	}

	display_data(clear_buffer, sizeof(clear_buffer));
}

uint8_t display_validate_column(uint8_t column) {
	if(column > 127 ||column < 0) return -1;
	return column;
}

void display_go_to_column(uint8_t column) {
	column = display_validate_column(column);
	if (column == -1) return;
	uint8_t msb = (column & 0xF0) >> 4;
	uint8_t lsb = (column & 0x0F);
	// Set the start and end positions for the nibbles
	uint8_t command = (0x00 | lsb);
	display_cmd(&command, 1);
	command = (0x10 | msb);
	display_cmd(&command, 1);
}

void display_clear_column(uint8_t column) {
	display_go_to_column(column);
	uint8_t clear_buffer = 0x00;

	for(int i = 0; i < 8; i++){
		display_go_to_line(i);
		display_data(&clear_buffer, 1);
	}
}

/* void display_position(uint8_t row,uint8_t column) {

} */

void display_print(char* letter, uint8_t page) {

	for (int i = 0; i < strlen(letter); i++){
		for (int j=0;j< 8;j++){
			ext_ram[(page*128+(64-strlen(letter)*4))+j+(8*i)] = pgm_read_byte(&font8[letter[i]-32][j]);
			//printf("%c",ext_ram[j+(8*i)]);
		}
	}
	//display_data(ext_ram, 128);
}

void display_all_pages() {
	for(int i = 0; i < 8; i++){
		uint8_t page_start []= {0xb0 | i};
		display_cmd(page_start,1);
		//printf("%c",ext_ram[i*128]);
		display_data(&ext_ram[i*128], 128);
	}
}

void display_init_SRAM(){
	SRAM_init();
	uint16_t ext_ram_size = 0x400;
	volatile uint8_t *ext_ram = (uint8_t *) 0x1400; // Start address for the SRAM
	
	for (uint16_t i = 0; i < ext_ram_size; i++) {
		uint8_t some_value = 0xFF; // TO change
		ext_ram[i] = 0;
	}
}

void display_pixel_on(uint8_t x, uint8_t y){
	uint8_t page = y/8;
	uint8_t bit_in_page = y % 8;
	ext_ram[(y/8)*128+x] |= (1 << bit_in_page);
}

void display_pixel_off(uint8_t x, uint8_t y){
	uint8_t page = y/8;
	uint8_t bit_in_page = y % 8;
	ext_ram[(y/8)*128+x] &= ~(1 << bit_in_page);
}

void draw_filled_circle(uint8_t cx, uint8_t cy, uint8_t r){
	for(int y = -r; y <= r; y++){
		int dx = (int)(sqrt((double)(r*r-y*y)) + 0.5);
		for(int x = -dx; x <= dx; x++) display_pixel_on(cx+x,cy+y);
	}
}

void display_invert_page(uint8_t page){
	for (int i = 0; i < 128; i++){
		ext_ram[page*128+i] = ~ext_ram[page*128+i];
	}
	
}

void display_print_menu(uint8_t page , menu menu_lines ){
	for(int i = 0; i < menu_lines.length; i++){
		display_print(menu_lines.menu_items[i],i);
	}
	display_invert_page(page);
}


uint8_t display_update_menu(menu_pos* menu_p, menu menu_lines){
	updateJoystick();
	if(joystick_btn_press()){
		return menu_p->current_pos;
	}
	if(menu_p->previous_joystick_pos != controller.dir){
		if(controller.dir == 0){
			menu_p->previous_pos = menu_p->current_pos;
			if(menu_p->current_pos > 2){
				menu_p->current_pos --;
			}
			else{
				menu_p->current_pos = menu_lines.length-1;
				menu_p->previous_pos = 2;
			}
			display_invert_page(menu_p->previous_pos);
			display_print_menu(menu_p->current_pos,menu_lines);
	
			menu_p->previous_joystick_pos = 0;
		}
		else if(controller.dir == 1){
			menu_p->previous_pos = menu_p->current_pos;
			if(menu_p->current_pos < menu_lines.length-1){
				menu_p->current_pos ++;
			}
			else{
				menu_p->current_pos = 2;
				menu_p->previous_pos = menu_lines.length-1;
			}
			display_invert_page(menu_p->previous_pos);
			display_print_menu(menu_p->current_pos,menu_lines);
			menu_p->previous_joystick_pos = 1;
		}
		else if(controller.dir == 4){ // Neutral position
			menu_p->previous_joystick_pos = 4;
		}
		}
		display_all_pages();
		return 0;
}



// 
// void display_line(uint8_t start, uint8_t end){
// 	uint8_t command_start_line = 0xB0;
// 	spi_write_bytes(&command_start_line, 1, DISPLAY);
// 	
// 	uint8_t command_start_nibble = (0x00 | start & 0x0F);
// 	spi_write_bytes(&command_start_nibble, 1, DISPLAY);
// } 


const unsigned char font8[95][8] PROGMEM = {
	{0b00000000,0b00000000,0b00000000,0b00000000,0b00000000,0b00000000,0b00000000,0b00000000}, //
	{0b00000000,0b00000110,0b01011111,0b01011111,0b00000110,0b00000000,0b00000000,0b00000000}, // !
	{0b00000000,0b00000111,0b00000111,0b00000000,0b00000111,0b00000111,0b00000000,0b00000000}, // "
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	{0b00000010,0b00000011,0b00000001,0b00000011,0b00000010,0b00000011,0b00000001,0b00000000}, // ~
};

// Font 5x7 - normal
const unsigned char font5[95][5] PROGMEM = {
	{0b00000000,0b00000000,0b00000000,0b00000000,0b00000000}, //
	{0b00000000,0b00000000,0b01011111,0b00000000,0b00000000}, // !
	{0b00000000,0b00000111,0b00000000,0b00000111,0b00000000}, // "
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	{0b00000010,0b00000001,0b00000011,0b00000010,0b00000001}, // ~
};

// Font 4x6 - Small
const unsigned char  font4[95][4] PROGMEM = {
	{0b00000000,0b00000000,0b00000000,0b00000000}, //
	{0b00000000,0b01011100,0b00000000,0b00000000}, // !
	{0b00001100,0b00000000,0b00001100,0b00000000}, // "
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	{0b00001000,0b00000100,0b00001000,0b00000100}, // ~
};
